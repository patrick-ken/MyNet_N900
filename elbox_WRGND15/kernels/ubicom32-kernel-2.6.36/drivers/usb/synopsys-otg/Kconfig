## elbox_WRGND15/kernels/ubicom32-kernel-2.6.36/drivers/usb/synopsys-otg/Kconfig
```kconfig
choice
	prompt "DWC Driver mode"
	default DWC_MODE_OTG

config DWC_MODE_OTG
	bool "OTG"
	help
	  This option enables the driver to follow the USB OTG spec and 
	  can dynamically switch between host role and device role.

config DWC_MODE_HOST_ONLY
	bool "Host Only"
	help
	  This option will compile the driver in host-only mode.

config DWC_MODE_DEVICE_ONLY
	bool "Device Only"
	help
	  This option will compile the driver in device-only mode.

endchoice

config DWC_DEBUG
	bool "Debug"
	help
	  This option will compile the driver with debug on.
```

## elbox_WRGND15/kernels/ubicom32-kernel-2.6.36/net/bridge/Kconfig
```kconfig
#
# 802.1d Ethernet Bridging
#

config BRIDGE
	tristate "802.1d Ethernet Bridging"
	select LLC
	select STP
	---help---
	  If you say Y here, then your Linux box will be able to act as an
	  Ethernet bridge, which means that the different Ethernet segments it
	  is connected to will appear as one Ethernet to the participants.
	  Several such bridges can work together to create even larger
	  networks of Ethernets using the IEEE 802.1 spanning tree algorithm.
	  As this is a standard, Linux bridges will cooperate properly with
	  other third party bridge products.

	  In order to use the Ethernet bridge, you'll need the bridge
	  configuration tools; see <file:Documentation/networking/bridge.txt>
	  for location. Please read the Bridge mini-HOWTO for more
	  information.

	  If you enable iptables support along with the bridge support then you
	  turn your bridge into a bridging IP firewall.
	  iptables will then see the IP packets being bridged, so you need to
	  take this into account when setting up your firewall rules.
	  Enabling arptables support when bridging will let arptables see
	  bridged ARP traffic in the arptables FORWARD chain.

	  To compile this code as a module, choose M here: the module
	  will be called bridge.

	  If unsure, say N.

config BRIDGE_IGMP_SNOOPING
	bool "IGMP/MLD snooping"
	depends on BRIDGE
	depends on INET
	default y
	---help---
	  If you say Y here, then the Ethernet bridge will be able selectively
	  forward multicast traffic based on IGMP/MLD traffic received from
	  each port.

	  Say N to exclude this support and reduce the binary size.

	  If unsure, say Y.

config BRIDGE_HARDWARE_MULTICAST_SNOOP
	bool "Hardware snooping"
	depends on BRIDGE
	---help---
	  If you want implement hardware snooping, you have set three configs.
	  set CONFIG_BRIDGE_IGMP_SNOOPING=y, CONFIG_BRIDGE_ALPHA_MULTICAST_SNOOP=y,
	  and CONFIG_BRIDGE_HARDWARE_MULTICAST_SNOOP=y.
	  It will implement the hardware snooping and do wireless enhance mode. 

config BRIDGE_ALPHA_MULTICAST_SNOOP
	bool "Bridge with Multicast snooping and wireless enhance support"
	depends on BRIDGE
	---help---
	  Deliver support for multicast table, which allow to do multicast snooping
	  (if implemented in switch) and do wireless enhance mode.
	  Wireless enhance mode will convert multicast data packet to unicast data.
	  Note : this option can't be used together with BRIDGE_IGMPP_PROCFS, since
	  it is intended to replace the BRIDGE_IGMPP_PROCFS in the future.

config BRIDGE_MULTICAST_BWCTRL
	bool "Multicast packet bandwidth control"
	depends on BRIDGE
	---help---

config BRIDGE_REJECT_FORWARD_LIST
    bool "Forwarding deny list support"
    depends on BRIDGE
    ---help---
```
